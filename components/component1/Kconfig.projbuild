## components/component1/Kconfig.projbuild
```kconfig
menu "Component1 FreeRTOS Task Delay"

    config COM1_TASK_DELAY_MS
        int "Task1 Delay in ms"
        range 100 1000
        default 1000
        help
            FreeRTOS vTaskDelay Parameter.

endmenu
```

## components/component2/Kconfig.projbuild
```kconfig
menu "Component2 FreeRTOS Task Delay"

    config COM2_TASK_DELAY_MS
        int "Task2 Delay in ms"
        range 100 1000
        default 500
        help
            FreeRTOS vTaskDelay Parameter.

endmenu
```
